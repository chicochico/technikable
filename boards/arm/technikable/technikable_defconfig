## boards/arm/technikable/technikable_defconfig
```kconfig
# SPDX-License-Identifier: MIT

CONFIG_SOC_SERIES_NRF52X=y
CONFIG_SOC_NRF52840_QIAA=y
CONFIG_BOARD_TECHNIKABLE=y

# Enable MPU
CONFIG_ARM_MPU=y

# enable GPIO
CONFIG_GPIO=y

# Power management
CONFIG_ZMK_SLEEP=y  # enable deep sleep (disconnect from BT) 
CONFIG_ZMK_IDLE_TIMEOUT=300000  # in milliseconds (5 minutes)
CONFIG_ZMK_IDLE_SLEEP_TIMEOUT=1800000  # in milliseconds (30 minutes)

CONFIG_USE_DT_CODE_PARTITION=y
CONFIG_BUILD_OUTPUT_UF2=y

CONFIG_MPU_ALLOW_FLASH_WRITE=y
CONFIG_NVS=y
CONFIG_SETTINGS_NVS=y
CONFIG_FLASH=y
CONFIG_FLASH_PAGE_LAYOUT=y
CONFIG_FLASH_MAP=y

# Bluetooth
CONFIG_ZMK_BLE_EXPERIMENTAL_CONN=y
```

## west.yml
```yaml
manifest:
  remotes:
    - name: zmkfirmware
      url-base: https://github.com/zmkfirmware
  projects:
    - name: zmk
      remote: zmkfirmware
      revision: 58ccc5970dc804857d81609857d4217278ec025c
      import: app/west.yml
  self:
    path: config
```
